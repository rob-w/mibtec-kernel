## Documentation/devicetree/bindings/iio/adc/ltc2499.txt
```
Linear Technology LTC 2499 ADC device driver

Required properties:
	- compatible: Must be "ltc,ltc2499";
	- channels: bitmask to enable each channel;
Optional properties:
	- speedmode: either 0(default) or 1
	- prefetchpause: 0 = off(default) no prefetching at all
					[INT] = milliseconds
						the timeout between sampling all channels
	- channels: bitmask to enable which channel in prefetcher

Example:
		ltc2499@16 {
			compatible = "ltc,ltc2499";
			reg = <0x14>;
			status = "okay";
			speedmode = <1>;
			prefetch = <200>;
		};
```

## Documentation/devicetree/bindings/iio/counter/cnt-dmtimer.txt
```
Device-Tree Bindings for a Counter driver using Omap Timers

Required properties:
- compatible: should be "cnt-gmtimer"
- gpios: one PPS GPIO in the format described by ../gpio/gpio.txt

Optional properties:
- assert-falling-edge: when present, assert is indicated by a falling edge
                       (instead of by a rising edge)

Example:

	cnt_gmtimer {
		pinctrl-names = "default";
		pinctrl-0 = <&timer6_pin>;

		timer = <&timer6>;

		compatible = "cnt-dmtimer";
		status = "okay";
	};
```

## Documentation/devicetree/bindings/iio/dac/mcp4725.txt
```
Microchip mcp4725 / mcp4728 DAC device driver

Required properties:
	- compatible: Must be "mcp,mcp4725"
	- vref_mv: either 0 for internal ref, or 2000 or 2500 mV
	- scale: global value to scale all channels initially
	- channel_type: 0 = voltage, 1 = current

Example:
		mcp4725@60 {
			compatible = "mcp,mcp4725";
			reg = <0x60>;
			status = "okay";
			vref_mv = <2500>;
			scale = <22567>;
			channel_type = <0>;
		};
```

## Documentation/devicetree/bindings/iio/light/veml7700.txt
```
* Vishay Ambient light sensor VEML7700

Required properties:
 - compatible: Should be
	"vishay,veml7700"
 - reg: I2C address for the device

Example:
ambient@0 {
	compatible = "vishay,veml7700";
	reg = <0x10>;
};
```

## drivers/iio/counter/Kconfig
```kconfig
#
# Counter devices
#
# When adding new entries keep the list in alphabetical order

menu "Counters"

config CNT_DMTIMER
	tristate "Omap Timer counter driver"
	depends on ARCH_OMAP2 || ARCH_OMAP3 || SOC_AM33XX || SOC_AM43XX
	help
	  Select this option to enable a Omap Timer to capture counts.

	  To compile this driver as a module, choose M here: the
	  module will be called cnt-dmtimer.

config CNT_GPIO
	tristate "gpio counter driver"
	help
	  Select this option to enable a gpios to capture counts.

	  To compile this driver as a module, choose M here: the
	  module will be called cnt-gpio.

endmenu
```

## drivers/staging/edredaq/Kconfig
```kconfig
# EDR Enhanced Data Acquisition Kernel Configuration
#

menu "EDREDAQ support"

# EDREDAQ
config EDREDAQ
	tristate "Support for EDR Enhanced Data Acquisition Devices"
	---help---
	  Support EDR Enhanced Data Acquisition by Eagle Technology.
	  Make sure the choose M for module support.

source "drivers/staging/edredaq/class/Kconfig"

source "drivers/staging/edredaq/udaqlite/Kconfig"

endmenu
```

## drivers/staging/edredaq/class/Kconfig
```kconfig
#
# EDR Enhanced Class Driver
#
config EDREDAQ_CLASS
	tristate "EDR Enhanced Class Driver"
	depends on EDREDAQ
	---help---
	  This driver is needed by all EDR Enhanced supported drivers.
```

## drivers/staging/edredaq/udaqlite/Kconfig
```kconfig
#
# USB MicroDAQLite Driver Support
#
config EDREDAQ_UDAQLITE
	tristate "USB MicroDAQLite Device Driver Support"
	depends on USB && EDREDAQ_CLASS
	---help---
	  Say M if you want support for the USB MicroDAQLite device.
```
